/* Copyright (c) 2012-2015, The Linux Foundation. All rights reserved.
 * Copyright (C) 2019 XiaoMi, Inc.
 *
 * This program is free software; you can redistribute it and/or modify
 * it under the terms of the GNU General Public License version 2 and
 * only version 2 as published by the Free Software Foundation.
 *
 * This program is distributed in the hope that it will be useful,
 * but WITHOUT ANY WARRANTY; without even the implied warranty of
 * MERCHANTABILITY or FITNESS FOR A PARTICULAR PURPOSE.  See the
 * GNU General Public License for more details.
 */

&mdss_mdp {
	dsi_td4310_fhdplus_e7_g55_vid: qcom,mdss_dsi_td4310_fhdplus_video_e7_g55 {
		qcom,mdss-dsi-panel-name = "td4310 fhdplus e7 g55 video mode dsi panel";
		qcom,mdss-dsi-panel-type = "dsi_video_mode";
		qcom,mdss-dsi-panel-framerate = <60>;
		qcom,mdss-dsi-virtual-channel-id = <0>;
		qcom,mdss-dsi-stream = <0>;
		qcom,mdss-dsi-panel-width = <1080>;
		qcom,mdss-dsi-panel-height = <2160>;
		qcom,mdss-dsi-h-front-porch = <108>;
		qcom,mdss-dsi-h-back-porch = <60>;
		qcom,mdss-dsi-h-pulse-width = <12>;
		qcom,mdss-dsi-h-sync-skew = <0>;
		qcom,mdss-dsi-v-back-porch = <33>;
		qcom,mdss-dsi-v-front-porch = <6>;
		qcom,mdss-dsi-v-pulse-width = <4>;
		qcom,mdss-dsi-h-left-border = <0>;
		qcom,mdss-dsi-h-right-border = <0>;
		qcom,mdss-dsi-v-top-border = <0>;
		qcom,mdss-dsi-v-bottom-border = <0>;
		qcom,mdss-dsi-bpp = <24>;
		qcom,mdss-dsi-underflow-color = <0xff>;
		qcom,mdss-dsi-border-color = <0>;

		qcom,mdss-dsi-on-command = [
			39 01 00 00 78 00 02 11 00
			29 01 00 00 00 00 02 B0 04
			29 01 00 00 00 00 02 D6 01
			//29 01 00 00 00 00 27 C7 00 1A 29 3C 4B 57 6F 7F 8C 97 49 55 63 77 80 8C 9B A6 B2 00 1A 29 3C 4B 57 6F 7F 8C 97 49 55 63 77 80 8C 9B A6 B2
			//29 01 00 00 00 00 38 C8 03 00 01 01 02 FE 00 00 FE FF 02 F3 00 00 01 FD 01 EE 00 00 FF 01 01 F6 00 00 01 FE 03 EC 00 00 01 FC FE FE 00 00 01 01 02 FE 00 00 FF FF 02 E9 00 00 01 FE 01 CD 00
			29 01 00 00 00 00 27 C7 00 19 28 3B 4A 55 6D 7D 8A 96 48 54 62 76 7F 8B 99 A4 B2 00 19 28 3B 4A 55 6D 7D 8A 96 48 54 62 76 7F 8B 99 A4 B2
			29 01 00 00 00 00 38 C8 03 00 01 03 FF FE 00 00 FE 01 FD F7 00 00 01 FF FB F2 00 00 01 03 01 EC 00 00 FE 01 FD F5 00 00 01 FE FA FE 00 00 01 03 FF FE 00 00 FE 01 FD EC 00 00 FE 01 FB D3 00
                        39 01 00 00 00 00 02 51 ff
			39 01 00 00 00 00 02 53 24
			39 01 00 00 00 00 02 55 00
			39 01 00 00 00 00 02 35 00
			39 01 00 00 14 00 02 29 00
		];

		qcom,mdss-dsi-on-command-01 = [
			39 01 00 00 78 00 02 11 00
			29 01 00 00 00 00 02 B0 04
			29 01 00 00 00 00 02 D6 01
			29 01 00 00 00 00 27 C7 00 1A 29 3C 4B 57 6F 7F 8C 97 49 55 63 77 80 8C 9B A6 B2 00 1A 29 3C 4B 57 6F 7F 8C 97 49 55 63 77 80 8C 9B A6 B2
			29 01 00 00 00 00 38 C8 01 00 FD FB FA B1 00 00 FF FB FF FC 00 00 FE FB FC AF 00 00 01 03 01 EC 00 00 FE 01 FD F5 00 00 01 FE FA FE 00 00 01 03 FF FE 00 00 FE 01 FD EC 00 00 FE 01 FB D3 00
			39 01 00 00 00 00 02 51 ff
			39 01 00 00 00 00 02 53 24
			39 01 00 00 00 00 02 55 00
			39 01 00 00 00 00 02 35 00
			39 01 00 00 14 00 02 29 00
		];

		qcom,mdss-dsi-on-command-02 = [
			39 01 00 00 78 00 02 11 00
			29 01 00 00 00 00 02 B0 04
			29 01 00 00 00 00 02 D6 01
			29 01 00 00 00 00 27 C7 00 1A 29 3C 4B 57 6F 7F 8C 97 49 55 63 77 80 8C 9B A6 B2 00 1A 29 3C 4B 57 6F 7F 8C 97 49 55 63 77 80 8C 9B A6 B2
			29 01 00 00 00 00 38 C8 01 00 FD FA FD D7 00 00 FF FB FF FC 00 00 FD FB FD D4 00 00 01 03 01 EC 00 00 FE 01 FD F5 00 00 01 FE FA FE 00 00 01 03 FF FE 00 00 FE 01 FD EC 00 00 FE 01 FB D3 00
			39 01 00 00 00 00 02 51 ff
			39 01 00 00 00 00 02 53 24
			39 01 00 00 00 00 02 55 00
			39 01 00 00 00 00 02 35 00
			39 01 00 00 14 00 02 29 00
		];

		qcom,mdss-dsi-on-command-03 = [
			39 01 00 00 78 00 02 11 00
			29 01 00 00 00 00 02 B0 04
			29 01 00 00 00 00 02 D6 01
			29 01 00 00 00 00 27 C7 00 1A 29 3C 4B 57 6F 7F 8C 97 49 55 63 77 80 8C 9B A6 B2 00 1A 29 3C 4B 57 6F 7F 8C 97 49 55 63 77 80 8C 9B A6 B2
			29 01 00 00 00 00 38 C8 01 00 FD FA FF FC 00 00 FE FB FB D6 00 00 FD FB FD FC 00 00 01 03 01 EC 00 00 FE 01 FD F5 00 00 01 FE FA FE 00 00 01 03 FF FE 00 00 FE 01 FD EC 00 00 FE 01 FB D3 00
			39 01 00 00 00 00 02 51 ff
			39 01 00 00 00 00 02 53 24
			39 01 00 00 00 00 02 55 00
			39 01 00 00 00 00 02 35 00
			39 01 00 00 14 00 02 29 00
		];

		qcom,mdss-dsi-on-command-04 = [
			39 01 00 00 78 00 02 11 00
			29 01 00 00 00 00 02 B0 04
			29 01 00 00 00 00 02 D6 01
			29 01 00 00 00 00 27 C7 00 1A 29 3C 4B 57 6F 7F 8C 97 49 55 63 77 80 8C 9B A6 B2 00 1A 29 3C 4B 57 6F 7F 8C 97 49 55 63 77 80 8C 9B A6 B2
			29 01 00 00 00 00 38 C8 01 00 FD FA FF FC 00 00 FF FB FB AE 00 00 FD FB FE FB 00 00 01 03 01 EC 00 00 FE 01 FD F5 00 00 01 FE FA FE 00 00 01 03 FF FE 00 00 FE 01 FD EC 00 00 FE 01 FB D3 00
			39 01 00 00 00 00 02 51 ff
			39 01 00 00 00 00 02 53 24
			39 01 00 00 00 00 02 55 00
			39 01 00 00 00 00 02 35 00
			39 01 00 00 14 00 02 29 00
		];

		qcom,mdss-dsi-on-command-05 = [
			39 01 00 00 78 00 02 11 00
			29 01 00 00 00 00 02 B0 04
			29 01 00 00 00 00 02 D6 01
			29 01 00 00 00 00 27 C7 00 1A 29 3C 4B 57 6F 7F 8C 97 49 55 63 77 80 8C 9B A6 B2 00 1A 29 3C 4B 57 6F 7F 8C 97 49 55 63 77 80 8C 9B A6 B2
			29 01 00 00 00 00 38 C8 01 00 FE FF FE FC 00 00 FE FF FF 96 00 00 FE 01 02 8E 00 00 04 01 FD 97 00 00 03 FF FD B9 00 00 04 FC F8 FC 00 00 04 01 FE FC 00 00 03 FF FD C0 00 00 04 FF FE 53 00
			39 01 00 00 00 00 02 51 ff
			39 01 00 00 00 00 02 53 24
			39 01 00 00 00 00 02 55 00
			39 01 00 00 00 00 02 35 00
			39 01 00 00 14 00 02 29 00
		];

		qcom,mdss-dsi-on-command-06 = [
			39 01 00 00 78 00 02 11 00
			29 01 00 00 00 00 02 B0 04
			29 01 00 00 00 00 02 D6 01
			29 01 00 00 00 00 27 C7 00 1A 29 3C 4B 57 6F 7F 8C 97 49 55 63 77 80 8C 9B A6 B2 00 1A 29 3C 4B 57 6F 7F 8C 97 49 55 63 77 80 8C 9B A6 B2
			29 01 00 00 00 00 38 C8 01 00 FD FA FF FC 00 00 01 FB FD B9 00 00 FE FB FA BB 00 00 01 03 01 EC 00 00 FE 01 FD F5 00 00 01 FE FA FE 00 00 01 03 FF FE 00 00 FE 01 FD EC 00 00 FE 01 FB D3 00
			39 01 00 00 00 00 02 51 ff
			39 01 00 00 00 00 02 53 24
			39 01 00 00 00 00 02 55 00
			39 01 00 00 00 00 02 35 00
			39 01 00 00 14 00 02 29 00
		];

		qcom,mdss-dsi-on-command-07 = [
			39 01 00 00 78 00 02 11 00
			29 01 00 00 00 00 02 B0 04
			29 01 00 00 00 00 02 D6 01
			29 01 00 00 00 00 27 C7 00 1A 29 3C 4B 57 6F 7F 8C 97 49 55 63 77 80 8C 9B A6 B2 00 1A 29 3C 4B 57 6F 7F 8C 97 49 55 63 77 80 8C 9B A6 B2
			29 01 00 00 00 00 38 C8 01 00 FD FA FC B4 00 00 FF FB FF FC 00 00 FD FB FE F9 00 00 01 03 01 EC 00 00 FE 01 FD F5 00 00 01 FE FA FE 00 00 01 03 FF FE 00 00 FE 01 FD EC 00 00 FE 01 FB D3 00
			39 01 00 00 00 00 02 51 ff
			39 01 00 00 00 00 02 53 24
			39 01 00 00 00 00 02 55 00
			39 01 00 00 00 00 02 35 00
			39 01 00 00 14 00 02 29 00
		];

		qcom,mdss-dsi-on-command-08 = [
			39 01 00 00 78 00 02 11 00
			29 01 00 00 00 00 02 B0 04
			29 01 00 00 00 00 02 D6 01
			29 01 00 00 00 00 27 C7 00 1A 29 3C 4B 57 6F 7F 8C 97 49 55 63 77 80 8C 9B A6 B2 00 1A 29 3C 4B 57 6F 7F 8C 97 49 55 63 77 80 8C 9B A6 B2
			29 01 00 00 00 00 38 C8 01 00 FD FB FB 66 00 00 FF FB FF FC 00 00 FD FB FD F8 00 00 01 03 01 EC 00 00 FE 01 FD F5 00 00 01 FE FA FE 00 00 01 03 FF FE 00 00 FE 01 FD EC 00 00 FE 01 FB D3 00
			39 01 00 00 00 00 02 51 ff
			39 01 00 00 00 00 02 53 24
			39 01 00 00 00 00 02 55 00
			39 01 00 00 00 00 02 35 00
			39 01 00 00 14 00 02 29 00
		];

		qcom,mdss-dsi-on-command-09 = [
			39 01 00 00 78 00 02 11 00
			29 01 00 00 00 00 02 B0 04
			29 01 00 00 00 00 02 D6 01
			29 01 00 00 00 00 27 C7 00 1A 29 3C 4B 57 6F 7F 8C 97 49 55 63 77 80 8C 9B A6 B2 00 1A 29 3C 4B 57 6F 7F 8C 97 49 55 63 77 80 8C 9B A6 B2
			29 01 00 00 00 00 38 C8 01 00 FD FA FF FC 00 00 FF FB FD C5 00 00 FF FB FD 7A 00 00 01 03 01 EC 00 00 FE 01 FD F5 00 00 01 FE FA FE 00 00 01 03 FF FE 00 00 FE 01 FD EC 00 00 FE 01 FB D3 00
			39 01 00 00 00 00 02 51 ff
			39 01 00 00 00 00 02 53 24
			39 01 00 00 00 00 02 55 00
			39 01 00 00 00 00 02 35 00
			39 01 00 00 14 00 02 29 00
		];

		qcom,mdss-dsi-on-command-10 = [
			39 01 00 00 78 00 02 11 00
			29 01 00 00 00 00 02 B0 04
			29 01 00 00 00 00 02 D6 01
			29 01 00 00 00 00 27 C7 00 1A 29 3C 4B 57 6F 7F 8C 97 49 55 63 77 80 8C 9B A6 B2 00 1A 29 3C 4B 57 6F 7F 8C 97 49 55 63 77 80 8C 9B A6 B2
			29 01 00 00 00 00 38 C8 01 00 FE FF FE FC 00 00 FE FF FF BA 00 00 FE 01 02 8C 00 00 04 01 FD 97 00 00 03 FF FD B9 00 00 04 FC F8 FC 00 00 04 01 FE FC 00 00 03 FF FD CC 00 00 04 FF FE 53 00
			39 01 00 00 00 00 02 51 ff
			39 01 00 00 00 00 02 53 24
			39 01 00 00 00 00 02 55 00
			39 01 00 00 00 00 02 35 00
			39 01 00 00 14 00 02 29 00
		];

		qcom,mdss-dsi-on-command-11 = [
			39 01 00 00 78 00 02 11 00
			29 01 00 00 00 00 02 B0 04
			29 01 00 00 00 00 02 D6 01
			29 01 00 00 00 00 27 C7 00 1A 29 3C 4B 57 6F 7F 8C 97 49 55 63 77 80 8C 9B A6 B2 00 1A 29 3C 4B 57 6F 7F 8C 97 49 55 63 77 80 8C 9B A6 B2
			29 01 00 00 00 00 38 C8 01 00 FE FF FE FC 00 00 FF FF 02 70 00 00 FE 01 02 8F 00 00 04 01 FD 97 00 00 03 FF FD B9 00 00 04 FC F8 FC 00 00 04 01 FE FC 00 00 03 FF FD CC 00 00 04 FF FE 53 00
			39 01 00 00 00 00 02 51 ff
			39 01 00 00 00 00 02 53 24
			39 01 00 00 00 00 02 55 00
			39 01 00 00 00 00 02 35 00
			39 01 00 00 14 00 02 29 00
		];

		qcom,mdss-dsi-on-command-12 = [
			39 01 00 00 78 00 02 11 00
			29 01 00 00 00 00 02 B0 04
			29 01 00 00 00 00 02 D6 01
			29 01 00 00 00 00 27 C7 00 1A 29 3C 4B 57 6F 7F 8C 97 49 55 63 77 80 8C 9B A6 B2 00 1A 29 3C 4B 57 6F 7F 8C 97 49 55 63 77 80 8C 9B A6 B2
			29 01 00 00 00 00 38 C8 01 00 FE FF FE FC 00 00 FD 01 01 4C 00 00 FE 01 02 90 00 00 04 01 FD 97 00 00 03 FF FD B9 00 00 04 FC F8 FC 00 00 04 01 FE FC 00 00 03 FF FD CC 00 00 04 FF FE 53 00
			39 01 00 00 00 00 02 51 ff
			39 01 00 00 00 00 02 53 24
			39 01 00 00 00 00 02 55 00
			39 01 00 00 00 00 02 35 00
			39 01 00 00 14 00 02 29 00
		];

		qcom,mdss-dsi-on-command-13 = [
			39 01 00 00 78 00 02 11 00
			29 01 00 00 00 00 02 B0 04
			29 01 00 00 00 00 02 D6 01
			29 01 00 00 00 00 27 C7 00 1A 29 3C 4B 57 6F 7F 8C 97 49 55 63 77 80 8C 9B A6 B2 00 1A 29 3C 4B 57 6F 7F 8C 97 49 55 63 77 80 8C 9B A6 B2
			29 01 00 00 00 00 38 C8 01 00 FC FB FF F4 00 00 FF FB FF FC 00 00 FE FB FC AF 00 00 01 03 01 EC 00 00 FE 01 FD F5 00 00 01 FE FA FE 00 00 01 03 FF FE 00 00 FE 01 FD EC 00 00 FE 01 FB D3 00
			39 01 00 00 00 00 02 51 ff
			39 01 00 00 00 00 02 53 24
			39 01 00 00 00 00 02 55 00
			39 01 00 00 00 00 02 35 00
			39 01 00 00 14 00 02 29 00
		];

		qcom,mdss-dsi-on-command-14 = [
			39 01 00 00 78 00 02 11 00
			29 01 00 00 00 00 02 B0 04
			29 01 00 00 00 00 02 D6 01
			29 01 00 00 00 00 27 C7 00 1A 29 3C 4B 57 6F 7F 8C 97 49 55 63 77 80 8C 9B A6 B2 00 1A 29 3C 4B 57 6F 7F 8C 97 49 55 63 77 80 8C 9B A6 B2
			29 01 00 00 00 00 38 C8 01 00 FD FA FF FC 00 00 FE FB FD E0 00 00 FE FB FB B9 00 00 01 03 01 EC 00 00 FE 01 FD F5 00 00 01 FE FA FE 00 00 01 03 FF FE 00 00 FE 01 FD EC 00 00 FE 01 FB D3 00
			39 01 00 00 00 00 02 51 ff
			39 01 00 00 00 00 02 53 24
			39 01 00 00 00 00 02 55 00
			39 01 00 00 00 00 02 35 00
			39 01 00 00 14 00 02 29 00
		];

		qcom,mdss-dsi-on-command-15 = [
			39 01 00 00 78 00 02 11 00
			29 01 00 00 00 00 02 B0 04
			29 01 00 00 00 00 02 D6 01
			29 01 00 00 00 00 27 C7 00 1A 29 3C 4B 57 6F 7F 8C 97 49 55 63 77 80 8C 9B A6 B2 00 1A 29 3C 4B 57 6F 7F 8C 97 49 55 63 77 80 8C 9B A6 B2
			29 01 00 00 00 00 38 C8 01 00 FD FA FF FC 00 00 01 FB FD 94 00 00 FD FB FC BC 00 00 01 03 01 EC 00 00 FE 01 FD F5 00 00 01 FE FA FE 00 00 01 03 FF FE 00 00 FE 01 FD EC 00 00 FE 01 FB D3 00
			39 01 00 00 00 00 02 51 ff
			39 01 00 00 00 00 02 53 24
			39 01 00 00 00 00 02 55 00
			39 01 00 00 00 00 02 35 00
			39 01 00 00 14 00 02 29 00
		];

		qcom,mdss-dsi-on-command-16 = [
			39 01 00 00 78 00 02 11 00
			29 01 00 00 00 00 02 B0 04
			29 01 00 00 00 00 02 D6 01
			29 01 00 00 00 00 27 C7 00 1A 29 3C 4B 57 6F 7F 8C 97 49 55 63 77 80 8C 9B A6 B2 00 1A 29 3C 4B 57 6F 7F 8C 97 49 55 63 77 80 8C 9B A6 B2
			29 01 00 00 00 00 38 C8 01 00 FE FF FE FC 00 00 FD 01 FD 87 00 00 FD 01 01 CA 00 00 04 01 FD 97 00 00 03 FF FD B9 00 00 04 FC F8 FC 00 00 04 01 FE FC 00 00 03 FF FD CC 00 00 04 FF FE 53 00
			39 01 00 00 00 00 02 51 ff
			39 01 00 00 00 00 02 53 24
			39 01 00 00 00 00 02 55 00
			39 01 00 00 00 00 02 35 00
			39 01 00 00 14 00 02 29 00
		];

		qcom,mdss-dsi-on-command-17 = [
			39 01 00 00 78 00 02 11 00
			29 01 00 00 00 00 02 B0 04
			29 01 00 00 00 00 02 D6 01
			29 01 00 00 00 00 27 C7 00 1A 29 3C 4B 57 6F 7F 8C 97 49 55 63 77 80 8C 9B A6 B2 00 1A 29 3C 4B 57 6F 7F 8C 97 49 55 63 77 80 8C 9B A6 B2
			29 01 00 00 00 00 38 C8 01 00 FD FB FC 68 00 00 FF FB FF FC 00 00 FE FB FC AF 00 00 01 03 01 EC 00 00 FE 01 FD F5 00 00 01 FE FA FE 00 00 01 03 FF FE 00 00 FE 01 FD EC 00 00 FE 01 FB D3 00
			39 01 00 00 00 00 02 51 ff
			39 01 00 00 00 00 02 53 24
			39 01 00 00 00 00 02 55 00
			39 01 00 00 00 00 02 35 00
			39 01 00 00 14 00 02 29 00
		];

		qcom,mdss-dsi-on-command-18 = [
			39 01 00 00 78 00 02 11 00
			29 01 00 00 00 00 02 B0 04
			29 01 00 00 00 00 02 D6 01
			29 01 00 00 00 00 27 C7 00 1A 29 3C 4B 57 6F 7F 8C 97 49 55 63 77 80 8C 9B A6 B2 00 1A 29 3C 4B 57 6F 7F 8C 97 49 55 63 77 80 8C 9B A6 B2
			29 01 00 00 00 00 38 C8 01 00 FD FB FB 8D 00 00 FF FB FF FC 00 00 FE FB FC D3 00 00 01 03 01 EC 00 00 FE 01 FD F5 00 00 01 FE FA FE 00 00 01 03 FF FE 00 00 FE 01 FD EC 00 00 FE 01 FB D3 00
			39 01 00 00 00 00 02 51 ff
			39 01 00 00 00 00 02 53 24
			39 01 00 00 00 00 02 55 00
			39 01 00 00 00 00 02 35 00
			39 01 00 00 14 00 02 29 00
		];

		qcom,mdss-dsi-on-command-19 = [
			39 01 00 00 78 00 02 11 00
			29 01 00 00 00 00 02 B0 04
			29 01 00 00 00 00 02 D6 01
			29 01 00 00 00 00 27 C7 00 1A 29 3C 4B 57 6F 7F 8C 97 49 55 63 77 80 8C 9B A6 B2 00 1A 29 3C 4B 57 6F 7F 8C 97 49 55 63 77 80 8C 9B A6 B2
			29 01 00 00 00 00 38 C8 01 00 FD FA FD B8 00 00 FF FB FD D9 00 00 FD FB FD FC 00 00 01 03 01 EC 00 00 FE 01 FD F5 00 00 01 FE FA FE 00 00 01 03 FF FE 00 00 FE 01 FD EC 00 00 FE 01 FB D3 00
			39 01 00 00 00 00 02 51 ff
			39 01 00 00 00 00 02 53 24
			39 01 00 00 00 00 02 55 00
			39 01 00 00 00 00 02 35 00
			39 01 00 00 14 00 02 29 00
		];

		qcom,mdss-dsi-on-command-20 = [
			39 01 00 00 78 00 02 11 00
			29 01 00 00 00 00 02 B0 04
			29 01 00 00 00 00 02 D6 01
			29 01 00 00 00 00 27 C7 00 1A 29 3C 4B 57 6F 7F 8C 97 49 55 63 77 80 8C 9B A6 B2 00 1A 29 3C 4B 57 6F 7F 8C 97 49 55 63 77 80 8C 9B A6 B2
			29 01 00 00 00 00 38 C8 01 00 FE FF FC CF 00 00 FD 01 FC BB 00 00 FD 01 FD FC 00 00 04 01 FD 97 00 00 03 FF FD B9 00 00 04 FC F8 FC 00 00 04 01 FE FC 00 00 03 FF FD CC 00 00 04 FF FE 53 00
			39 01 00 00 00 00 02 51 ff
			39 01 00 00 00 00 02 53 24
			39 01 00 00 00 00 02 55 00
			39 01 00 00 00 00 02 35 00
			39 01 00 00 14 00 02 29 00
		];

		qcom,mdss-dsi-on-command-21 = [
			39 01 00 00 78 00 02 11 00
			29 01 00 00 00 00 02 B0 04
			29 01 00 00 00 00 02 D6 01
			29 01 00 00 00 00 27 C7 00 1A 29 3C 4B 57 6F 7F 8C 97 49 55 63 77 80 8C 9B A6 B2 00 1A 29 3C 4B 57 6F 7F 8C 97 49 55 63 77 80 8C 9B A6 B2
			29 01 00 00 00 00 38 C8 01 00 FD FC F8 20 00 00 FF FB FF FC 00 00 FE FB FC AF 00 00 01 03 01 EC 00 00 FE 01 FD F5 00 00 01 FE FA FE 00 00 01 03 FF FE 00 00 FE 01 FD EC 00 00 FE 01 FB D3 00
			39 01 00 00 00 00 02 51 ff
			39 01 00 00 00 00 02 53 24
			39 01 00 00 00 00 02 55 00
			39 01 00 00 00 00 02 35 00
			39 01 00 00 14 00 02 29 00
		];

		qcom,mdss-dsi-on-command-22 = [
			39 01 00 00 78 00 02 11 00
			29 01 00 00 00 00 02 B0 04
			29 01 00 00 00 00 02 D6 01
			29 01 00 00 00 00 27 C7 00 1A 29 3C 4B 57 6F 7F 8C 97 49 55 63 77 80 8C 9B A6 B2 00 1A 29 3C 4B 57 6F 7F 8C 97 49 55 63 77 80 8C 9B A6 B2
			29 01 00 00 00 00 38 C8 01 00 FE FB FB 42 00 00 FF FB FF FC 00 00 FD FB FC D2 00 00 01 03 01 EC 00 00 FE 01 FD F5 00 00 01 FE FA FE 00 00 01 03 FF FE 00 00 FE 01 FD EC 00 00 FE 01 FB D3 00
			39 01 00 00 00 00 02 51 ff
			39 01 00 00 00 00 02 53 24
			39 01 00 00 00 00 02 55 00
			39 01 00 00 00 00 02 35 00
			39 01 00 00 14 00 02 29 00
		];

		qcom,mdss-dsi-on-command-23 = [
			39 01 00 00 78 00 02 11 00
			29 01 00 00 00 00 02 B0 04
			29 01 00 00 00 00 02 D6 01
			29 01 00 00 00 00 27 C7 00 1A 29 3C 4B 57 6F 7F 8C 97 49 55 63 77 80 8C 9B A6 B2 00 1A 29 3C 4B 57 6F 7F 8C 97 49 55 63 77 80 8C 9B A6 B2
			29 01 00 00 00 00 38 C8 01 00 FD FB FA 6F 00 00 FE FB FC DC 00 00 FD FB FD FC 00 00 01 03 01 EC 00 00 FE 01 FD F5 00 00 01 FE FA FE 00 00 01 03 FF FE 00 00 FE 01 FD EC 00 00 FE 01 FB D3 00
			39 01 00 00 00 00 02 51 ff
			39 01 00 00 00 00 02 53 24
			39 01 00 00 00 00 02 55 00
			39 01 00 00 00 00 02 35 00
			39 01 00 00 14 00 02 29 00
		];

		qcom,mdss-dsi-on-command-24 = [
			39 01 00 00 78 00 02 11 00
			29 01 00 00 00 00 02 B0 04
			29 01 00 00 00 00 02 D6 01
			29 01 00 00 00 00 27 C7 00 1A 29 3C 4B 57 6F 7F 8C 97 49 55 63 77 80 8C 9B A6 B2 00 1A 29 3C 4B 57 6F 7F 8C 97 49 55 63 77 80 8C 9B A6 B2
			29 01 00 00 00 00 38 C8 01 00 FE FF FF 85 00 00 FC 01 FA C1 00 00 FD 01 FD FC 00 00 04 01 FD 97 00 00 03 FF FD B9 00 00 04 FC F8 FC 00 00 04 01 FE FC 00 00 03 FF FD CC 00 00 04 FF FE 53 00
			39 01 00 00 00 00 02 51 ff
			39 01 00 00 00 00 02 53 24
			39 01 00 00 00 00 02 55 00
			39 01 00 00 00 00 02 35 00
			39 01 00 00 14 00 02 29 00
		];

		qcom,mdss-dsi-off-command = [
			39 01 00 00 14 00 02 28 00
			39 01 00 00 78 00 02 10 00
		];

		qcom,mdss-dsi-on-command-state = "dsi_lp_mode";
		qcom,mdss-dsi-off-command-state = "dsi_hs_mode";
		qcom,mdss-dsi-h-sync-pulse = <1>;
		qcom,mdss-dsi-traffic-mode = "burst_mode";
		qcom,mdss-dsi-bllp-eof-power-mode;
		qcom,mdss-dsi-bllp-power-mode;
		qcom,mdss-dsi-lane-0-state;
		qcom,mdss-dsi-lane-1-state;
		qcom,mdss-dsi-lane-2-state;
		qcom,mdss-dsi-lane-3-state;
		qcom,mdss-dsi-panel-timings = [7d 25 1d 00 37 33
			22 27 1e 03 04 00];
		qcom,mdss-dsi-t-clk-post = <0x0E>;
		qcom,mdss-dsi-t-clk-pre = <0x35>;
		qcom,mdss-dsi-bl-min-level = <1>;
		qcom,mdss-dsi-bl-max-level = <4095>;
		qcom,mdss-dsi-dma-trigger = "trigger_sw";
		qcom,mdss-dsi-mdp-trigger = "none";
		qcom,mdss-dsi-bl-pmic-control-type = "bl_ctrl_wled";
		qcom,mdss-dsi-reset-sequence = <1 5>, <0 5>, <1 30>;
                //qcom,mdss-dsi-tx-eot-append;
		qcom,esd-check-enabled;
		qcom,mdss-dsi-panel-status-command = [06 01 00 01 05 00 01 0A];
		qcom,mdss-dsi-panel-status-command-mode = "dsi_lp_mode";
		qcom,mdss-dsi-panel-status-check-mode = "TE_check_NT35596";
		qcom,mdss-dsi-panel-status-read-length = <1>;
		qcom,mdss-dsi-panel-status-value = <0x9C>;
		qcom,mdss-dsi-panel-max-error-count = <3>;
		qcom,mdss-pan-physical-width-dimension = <69>;
		qcom,mdss-pan-physical-height-dimension = <122>;
	};
};
