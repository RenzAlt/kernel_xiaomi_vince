## drivers/staging/Kconfig
```kconfig
menuconfig STAGING
	bool "Staging drivers"
	default n
	---help---
	  This option allows you to select a number of drivers that are
	  not of the "normal" Linux kernel quality level.  These drivers
	  are placed here in order to get a wider audience to make use of
	  them.  Please note that these drivers are under heavy
	  development, may or may not work, and may contain userspace
	  interfaces that most likely will be changed in the near
	  future.

	  Using any of these drivers will taint your kernel which might
	  affect support options from both the community, and various
	  commercial support organizations.

	  If you wish to work on these drivers, to help improve them, or
	  to report problems you have with them, please see the
	  driver_name.README file in the drivers/staging/ directory to
	  see what needs to be worked on, and who to contact.

	  If in doubt, say N here.

config PRONTO_WLAN
	tristate "Qualcomm Atheros Pronto WLAN module"
	default n
	help
	  Add support for the Qualcomm Atheros Pronto WLAN module

config PRIMA_WLAN_BTAMP
	bool "Enable the Prima WLAN BT-AMP feature"
	default n

config PRIMA_WLAN_LFR
	bool "Enable the Prima WLAN Legacy Fast Roaming feature"
	default n

config PRIMA_WLAN_OKC
	bool "Enable the Prima WLAN Opportunistic Key Caching feature"
	default n

config PRIMA_WLAN_11AC_HIGH_TP
	bool "Enable the Prima WLAN 802.11ac High Throughput option (depends upon kernel support)"
	default n

config WLAN_FEATURE_11W
	bool "Enable the WLAN 802.11w Protected Management Frames feature"
	default n

config QCOM_VOWIFI_11R
	bool "Enable Fast Transition (11r) feature"
	default n

config ENABLE_LINUX_REG
	bool "Enable linux regulatory feature"
	default n

config WLAN_OFFLOAD_PACKETS
	bool "Enable offload packets feature"
	default n

config QCOM_TDLS
	bool "Enable TDLS feature"
	default n


if STAGING

source "drivers/staging/slicoss/Kconfig"

source "drivers/staging/wlan-ng/Kconfig"

source "drivers/staging/comedi/Kconfig"

source "drivers/staging/olpc_dcon/Kconfig"

source "drivers/staging/rtl8192u/Kconfig"

source "drivers/staging/rtl8192e/Kconfig"

source "drivers/staging/rtl8712/Kconfig"

source "drivers/staging/rtl8188eu/Kconfig"

source "drivers/staging/rts5208/Kconfig"

source "drivers/staging/octeon/Kconfig"

source "drivers/staging/octeon-usb/Kconfig"

source "drivers/staging/vt6655/Kconfig"

source "drivers/staging/vt6656/Kconfig"

source "drivers/staging/iio/Kconfig"

source "drivers/staging/sm750fb/Kconfig"

source "drivers/staging/xgifb/Kconfig"

source "drivers/staging/emxx_udc/Kconfig"

source "drivers/staging/speakup/Kconfig"

source "drivers/staging/nvec/Kconfig"

source "drivers/staging/media/Kconfig"

source "drivers/staging/android/Kconfig"

source "drivers/staging/board/Kconfig"

source "drivers/staging/gdm724x/Kconfig"

source "drivers/staging/fwserial/Kconfig"

source "drivers/staging/goldfish/Kconfig"

source "drivers/staging/netlogic/Kconfig"

source "drivers/staging/mt29f_spinand/Kconfig"

source "drivers/staging/lustre/Kconfig"

source "drivers/staging/dgnc/Kconfig"

source "drivers/staging/gs_fpgaboot/Kconfig"

source "drivers/staging/skein/Kconfig"

source "drivers/staging/unisys/Kconfig"

source "drivers/staging/clocking-wizard/Kconfig"

source "drivers/staging/fbtft/Kconfig"

source "drivers/staging/fsl-mc/Kconfig"

source "drivers/staging/wilc1000/Kconfig"

source "drivers/staging/most/Kconfig"

source "drivers/staging/i4l/Kconfig"

source "drivers/staging/ks7010/Kconfig"

source "drivers/staging/greybus/Kconfig"

source "drivers/staging/vc04_services/Kconfig"

endif # STAGING
```
